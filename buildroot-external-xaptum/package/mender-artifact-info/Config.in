## buildroot-external-xaptum/package/mender-artifact-info/Config.in
```kconfig
config BR2_PACKAGE_MENDER_ARTIFACT_INFO
	bool "mender-artifact-info"
	depends on BR2_PACKAGE_MENDER

	help
	  Generates the /etc/mender/artifact_info file. Joins the provided
	  name prefix and the output of `git describe --dirty --long` to
	  form the "artifact_name".

if BR2_PACKAGE_MENDER_ARTIFACT_INFO

config BR2_PACKAGE_MENDER_ARTIFACT_INFO_NAME_PREFIX
	string "Name prefix"
	help
	  Prefix for the name version. For example, the name of the
	  defconfig.

endif
```

## buildroot-external-xaptum/package/mender-certs/Config.in
```kconfig
config BR2_PACKAGE_MENDER_CERTS
	bool "mender-certs"
	depends on BR2_PACKAGE_MENDER

	help
	  Installs the public certificates to authenticate firmware
	  updates from the Xaptum Mender server.

	  https://github.com/xaptum/xaprc

choice
	prompt "Install certs for which environment"
	depends on BR2_PACKAGE_MENDER_CERTS

	config BR2_PACKAGE_MENDER_CERTS_DEV
		bool "dev"

	config BR2_PACKAGE_MENDER_CERTS_PROD
		bool "prod"

endchoice
```

## buildroot-external-xaptum/package/mender-identity/Config.in
```kconfig
config BR2_PACKAGE_MENDER_IDENTITY
	bool "mender-identity"
	depends on BR2_PACKAGE_MENDER

	help
	  Installs the Mender device identity script

	  https://github.com/xaptum/xaprc
```

## buildroot-external-xaptum/package/shellcat/Config.in
```kconfig
config BR2_PACKAGE_SHELLCAT
	bool "shellcat"
	help
	  Templating system with shell syntax

	  https://github.com/jwilk/shellcat
```

## buildroot-external-xaptum/package/tpm-proxy/Config.in
```kconfig
config BR2_PACKAGE_TPM_PROXY
	bool "tpm_proxy"
	depends on BR2_TOOLCHAIN_HAS_THREADS

	help
	  A driver to expose the TPM provisioning interface.

	  https://github.com/xaptum/tpm-proxy

comment "tpm-proxy needs a toolchain w/ threads"
        depends on !BR2_TOOLCHAIN_HAS_THREADS
```

## buildroot-external-xaptum/package/wpa-credentials/Config.in
```kconfig
config BR2_PACKAGE_WPA_CREDENTIALS
	bool "wpa-credentials"
	depends on BR2_PACKAGE_WPA_SUPPLICANT_NL80211

	help
	  Installs the wpa credentials on /data and symlinks to /etc

	  https://github.com/xaptum/xaprc


if BR2_PACKAGE_WPA_CREDENTIALS
config BR2_PACKAGE_WPA_CREDENTIALS_SSID
	string "SSID"
	default ""
	help
	  SSID name.

config BR2_PACKAGE_WPA_CREDENTIALS_PASS
	string "Password"
	default ""
	help
	  Wifi password
endif
```

## buildroot-external-xaptum/package/xap-hss/Config.in
```kconfig
config BR2_PACKAGE_XAP_HSS
	bool "Xaptum HSS"
	depends on BR2_LINUX_KERNEL
	select BR2_LINUX_KERNEL_EXT_HSS
	select BR2_PACKAGE_HSS_NET
	select BR2_PACKAGE_F_HSS

	help
	  Some text about HSS here

comment "Xaptum HSS needs a Linux kernel to be built"
        depends on !BR2_LINUX_KERNEL
```

## buildroot-external-xaptum/package/xap-usb-gadget/Config.in
```kconfig
config BR2_PACKAGE_XAP_USB_GADGET
	bool "xap_usb_gadget"

	help
	  A service to enable the Xaptum router card USB gadget

	  https://github.com/xaptum/xaprc

if BR2_PACKAGE_XAP_USB_GADGET
config BR2_PACKAGE_XAP_USB_GADGET_PRODUCT_STR
	string "Xaprc product string"
	help
	  The name of the device as it will appear on the host

config BR2_PACKAGE_XAP_USB_GADGET_PRODUCT_ID
	string "Xaprc product id"
	help
	  The USB product ID of the Xaptum USB gadget

config BR2_PACKAGE_XAP_USB_GADGET_SCM
	bool "Enable SCM gadget"
	default n
	help
	  Enable serial console (ACM) function in the USB gadget.

config BR2_PACKAGE_XAP_USB_GADGET_SERIAL
       bool "Include serial console in the Xaptum USB gadget"
       default n
	help
	  Enable the SCM function in the SCM gadget.
endif
```

## buildroot-external-xaptum/package/xapea00x/Config.in
```kconfig
config BR2_PACKAGE_XAPEA00X
	bool "xapea00x"
	help
	  xapea00x is a kernel driver for the XAP-EA-00x line of
	  Xaptum ENF Access modules.

	  https://github.com/xaptum/xapea00x
```

## buildroot-external-xaptum/package/xaprc_eval_tool/Config.in.host
```kconfig
config BR2_PACKAGE_HOST_XAPRC_EVAL_TOOL
	bool "host xaprc_eval_tool"
        select BR2_PACKAGE_HOST_LIBFTDI
	help
	  Helper tool for controlling the Xaptum Router Card evaluation
	  and development kit.
```

## buildroot-external-xaptum/package/xaptum-tpm/Config.in
```kconfig
config BR2_PACKAGE_XAPTUM_TPM
	bool "xaptum-tpm"
	help
	  Utilities for interacting with the TPM 2.0 chip used to access the
	  Xaptum Edge Network Fabric.

	  https://github.com/xaptum/xaptum-tpm

if BR2_PACKAGE_XAPTUM_TPM

config BR2_PACKAGE_XAPTUM_TPM_UTILS
       bool "Utility programs"
       default n
       help
         Install utility programs for examining the TPM contents.

endif
```

## buildroot-external-xaptum/package/xbridge/Config.in
```kconfig
config BR2_PACKAGE_XBRIDGE
	bool "xbridge"
	select BR2_PACKAGE_LIBPCAP

	help
	  A userspace application to bridge two network interfaces.

	  https://github.com/xaptum/xaprc
```
