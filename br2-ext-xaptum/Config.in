## buildroot-external-xaptum/configs/xaptum_xaprc001_defconfig
```kconfig
BR2_arm=y
BR2_cortex_a5=y
BR2_ARM_ENABLE_NEON=y
BR2_ARM_ENABLE_VFP=y
BR2_ARM_INSTRUCTIONS_THUMB2=y
BR2_CCACHE=y
BR2_PACKAGE_HOST_LINUX_HEADERS_CUSTOM_4_9=y
BR2_TOOLCHAIN_BUILDROOT_WCHAR=y
BR2_PTHREAD_DEBUG=y
BR2_TOOLCHAIN_BUILDROOT_CXX=y
BR2_ROOTFS_DEVICE_CREATION_DYNAMIC_EUDEV=y
BR2_ROOTFS_POST_IMAGE_SCRIPT="support/scripts/genimage.sh"
BR2_ROOTFS_POST_SCRIPT_ARGS="-c $(BR2_EXTERNAL_XAPTUM_PATH)/board/xaprc001/genimage.cfg"
BR2_LINUX_KERNEL=y
BR2_LINUX_KERNEL_CUSTOM_GIT=y
BR2_LINUX_KERNEL_CUSTOM_REPO_URL="https://github.com/drbild/linux-at91.git"
BR2_LINUX_KERNEL_CUSTOM_REPO_VERSION="xaptum"
BR2_LINUX_KERNEL_USE_CUSTOM_CONFIG=y
BR2_LINUX_KERNEL_CUSTOM_CONFIG_FILE="$(BR2_EXTERNAL_XAPTUM_PATH)/board/xaprc001/kernel.config"
BR2_LINUX_KERNEL_DTS_SUPPORT=y
BR2_LINUX_KERNEL_INTREE_DTS_NAME="at91-sama5d2_xplained at91-sama5d2_xplained_pda4 at91-sama5d2_xplained_pda7 at91-sama5d2_xplained_pda7b"
BR2_LINUX_KERNEL_INSTALL_TARGET=y
BR2_PACKAGE_BUSYBOX_SHOW_OTHERS=y
BR2_PACKAGE_USBUTILS=y
BR2_PACKAGE_IPROUTE2=y
BR2_PACKAGE_IPTABLES=y
BR2_PACKAGE_BASH=y
BR2_TARGET_ROOTFS_EXT2=y
BR2_TARGET_ROOTFS_EXT2_4=y
BR2_TARGET_AT91BOOTSTRAP3=y
BR2_TARGET_AT91BOOTSTRAP3_CUSTOM_GIT=y
BR2_TARGET_AT91BOOTSTRAP3_CUSTOM_REPO_URL="https://github.com/linux4sam/at91bootstrap.git"
BR2_TARGET_AT91BOOTSTRAP3_CUSTOM_REPO_VERSION="v3.8.9"
BR2_TARGET_AT91BOOTSTRAP3_DEFCONFIG="sama5d2_xplainedsd_uboot"
BR2_TARGET_UBOOT=y
BR2_TARGET_UBOOT_BUILD_SYSTEM_KCONFIG=y
BR2_TARGET_UBOOT_CUSTOM_GIT=y
BR2_TARGET_UBOOT_CUSTOM_REPO_URL="https://github.com/linux4sam/u-boot-at91.git"
BR2_TARGET_UBOOT_CUSTOM_REPO_VERSION="linux4sam_5.7"
BR2_TARGET_UBOOT_BOARD_DEFCONFIG="sama5d2_xplained_mmc"
BR2_TARGET_UBOOT_NEEDS_DTC=y
BR2_PACKAGE_HOST_DOSFSTOOLS=y
BR2_PACKAGE_HOST_GENIMAGE=y
BR2_PACKAGE_HOST_MTOOLS=y
BR2_PACKAGE_XAPTUM_TPM=y
BR2_PACKAGE_AMCL=y
BR2_PACKAGE_AMCL_MPIN=n
BR2_PACKAGE_AMCL_WCC=n
BR2_PACKAGE_AMCL_RSA=n
BR2_PACAKGE_AMCL_CURVE=y
BR2_PACKAGE_AMCL_CURVE_ANSSI=n
BR2_PACKAGE_AMCL_CURVE_BLS383=n
BR2_PACKAGE_AMCL_CURVE_BLS461=n
BR2_PACKAGE_AMCL_CURVE_BN254=n
BR2_PACKAGE_AMCL_CURVE_BN254CX=n
BR2_PACKAGE_AMCL_CURVE_BRAINPOOL=n
BR2_PACKAGE_AMCL_CURVE_C25519=n
BR2_PACKAGE_AMCL_CURVE_C41417=n
BR2_PACKAGE_AMCL_CURVE_ED25519=n
BR2_PACKAGE_AMCL_CURVE_FP256BN=y
BR2_PACKAGE_AMCL_CURVE_FP512BN=n
BR2_PACKAGE_AMCL_CURVE_GOLDILOCKS=n
BR2_PACKAGE_AMCL_CURVE_HIFIVE=n
BR2_PACKAGE_AMCL_CURVE_NIST256=n
BR2_PACKAGE_AMCL_CURVE_NIST384=n
BR2_PACKAGE_AMCL_CURVE_NIST521=n
BR2_PACKAGE_AMCL_CURVE_NUMS256E=n
BR2_PACKAGE_AMCL_CURVE_NUMS256W=n
BR2_PACKAGE_AMCL_CURVE_NUMS384E=n
BR2_PACKAGE_AMCL_CURVE_NUMS384W=n
BR2_PACKAGE_AMCL_CURVE_NUMS512E=n
BR2_PACKAGE_AMCL_CURVE_NUMS512W=n
```

## buildroot-external-xaptum/package/amcl/Config.in
```kconfig
config BR2_PACKAGE_AMCL
	bool "amcl"
	help
	  AMCL is a standards compliant C cryptographic library with no
	  external dependencies, specifically designed to support the
	  Internet of Things (IoT).

	  https://github.com/milagro-crypto/milagro-crypto-c

if BR2_PACKAGE_AMCL

menuconfig BR2_PACKAGE_AMCL_RSA
	bool "RSA support"
	default y
	help
	  Include support for RSA-based cryptography.

if BR2_PACKAGE_AMCL_RSA

config BR2_PACKAGE_AMCL_RSA_2048
	bool "2048 bit"
	default y

config BR2_PACKAGE_AMCL_RSA_3072
	bool "3072 bit"
	default y

config BR2_PACKAGE_AMCL_RSA_4096
	bool "4096 bit"

endif

menuconfig BR2_PACKAGE_AMCL_CURVE
	bool "ECC support"
	default y
	help
	   Include support for elliptic curve-based cryptography.

if BR2_PACKAGE_AMCL_CURVE

config BR2_PACKAGE_AMCL_CURVE_ANSSI
	bool "ANSSI"

config BR2_PACKAGE_AMCL_CURVE_BLS383
	bool "BLS383"

config BR2_PACKAGE_AMCL_CURVE_BLS461
	bool "BLS461"

config BR2_PACKAGE_AMCL_CURVE_BN254
	bool "BN254"

config BR2_PACKAGE_AMCL_CURVE_BN254CX
	bool "BN254CX"
	default y

config BR2_PACKAGE_AMCL_CURVE_BRAINPOOL
	bool "BRAINPOOL"

config BR2_PACKAGE_AMCL_CURVE_C25519
	bool "C25519"

config BR2_PACKAGE_AMCL_CURVE_C41417
	bool "C41417"

config BR2_PACKAGE_AMCL_CURVE_ED25519
	bool "ED25519"
	default y

config BR2_PACKAGE_AMCL_CURVE_FP256BN
	bool "FP256BN"

config BR2_PACKAGE_AMCL_CURVE_FP512BN
	bool "FP512BN"

config BR2_PACKAGE_AMCL_CURVE_GOLDILOCKS
	bool "GOLDILOCKS"
	default y

config BR2_PACKAGE_AMCL_CURVE_HIFIVE
	bool "HIFIVE"

config BR2_PACKAGE_AMCL_CURVE_NIST256
	bool "NIST256"
	default y

config BR2_PACKAGE_AMCL_CURVE_NIST384
	bool "NIST384"

config BR2_PACKAGE_AMCL_CURVE_NIST521
	bool "NIST521"

config BR2_PACKAGE_AMCL_CURVE_NUMS256E
	bool "NUMS256E"

config BR2_PACKAGE_AMCL_CURVE_NUMS256W
	bool "NUMS256W"

config BR2_PACKAGE_AMCL_CURVE_NUMS384E
	bool "NUMS483E"

config BR2_PACKAGE_AMCL_CURVE_NUMS384W
	bool "NUMS384W"

config BR2_PACKAGE_AMCL_CURVE_NUMS512E
	bool "NUMS512E"

config BR2_PACKAGE_AMCL_CURVE_NUMS512W
	bool "NUMS512W"

endif

config BR2_PACKAGE_AMCL_MPIN
	bool "M-PIN support"
	default y
	depends on BR2_PACKAGE_AMCL_CURVE_BLS383  || \
	           BR2_PACKAGE_AMCL_CURVE_BLS461  || \
	           BR2_PACKAGE_AMCL_CURVE_BN254   || \
	           BR2_PACKAGE_AMCL_CURVE_BN254CX || \
		   BR2_PACKAGE_AMCL_CURVE_FP256BN || \
	           BR2_PACKAGE_AMCL_CURVE_FP512BN
	help
	  Include support for M-PIN, a multi-factor, zero knowledge
	  authentication protocol intended to replace the well-known
	  Username/Password authentication mechanism.

if BR2_PACKAGE_AMCL_MPIN

config BR2_PACKAGE_AMCL_MPIN_MAXPIN
	int "maximum PIN value"
	default 10000
	help
	  The maximum allowable value for an M-PIN pin.

config BR2_PACKAGE_AMCL_MPIN_PBLEN
	int "maximum PIN length"
	default 14
	help
	  The maximum size in bits of an M-PIN pin.

endif

config BR2_PACKAGE_AMCL_WCC
	bool "WCC (Wang/Chow-Choo) support"
	default y
	depends on BR2_PACKAGE_AMCL_CURVE_BLS383  || \
	           BR2_PACKAGE_AMCL_CURVE_BLS461  || \
	           BR2_PACKAGE_AMCL_CURVE_BN254   || \
	           BR2_PACKAGE_AMCL_CURVE_BN254CX || \
		   BR2_PACKAGE_AMCL_CURVE_FP256BN || \
	           BR2_PACKAGE_AMCL_CURVE_FP512BN
	help
	  Include support for Wang/Chow-Choo identity-based key
	  agreement protocols.

endif
```

## buildroot-external-xaptum/package/captived/Config.in
```kconfig
config BR2_PACKAGE_CAPTIVED
	bool "captived"
	select BR2_PACKAGE_LIBEVENT
	select BR2_PACKAGE_JANSSON

	help
	  Captive server to direct traffic on the card.
```

## buildroot-external-xaptum/package/ecdaa/Config.in
```kconfig
config BR2_PACKAGE_ECDAA
	bool "ecdaa"
	select BR2_PACKAGE_AMCL
	select BR2_PACKAGE_AMCL_CURVE
	help
	  ECDAA is a C implementation of elliptic-curve-based
	  Direct Anonymous Attestation (DAA) signatures.

	  https://github.com/xaptum/ecdaa

if BR2_PACKAGE_ECDAA

config BR2_PACKAGE_ECDAA_TPM_SUPPORT
	bool "TPM support"
	default y
	select BR2_PACKAGE_XAPTUM_TPM
	help
	  Support using a TPM 2.0 for DAA signatures.

config BR2_PACKAGE_ECDAA_CURVE_BN254
	bool "BN254"
	select BR2_PACKAGE_AMCL_CURVE_BN254

config BR2_PACKAGE_ECDAA_CURVE_BN254CX
	bool "BN254CX"
	select BR2_PACKAGE_AMCL_CURVE_BN254CX

config BR2_PACKAGE_ECDAA_CURVE_BLS383
	bool "BLS383"
	select BR2_PACKAGE_AMCL_CURVE_BLS383

config BR2_PACKAGE_ECDAA_CURVE_FP256BN
	select BR2_PACKAGE_AMCL_CURVE_FP256BN
	bool "FP256BN"

endif
```

## buildroot-external-xaptum/package/enftun-cmd/Config.in
```kconfig
config BR2_PACKAGE_ENFTUN_CMD
	bool "enftun-cmd"
	depends on BR2_PACKAGE_ENFTUN

	help
	  Sets up the enftun data link on the Xaptum Router Card

	  https://github.com/xaptum/xaprc
```

## buildroot-external-xaptum/package/enftun-data/Config.in
```kconfig
config BR2_PACKAGE_ENFTUN_DATA
	bool "enftun-data"
	depends on BR2_PACKAGE_ENFTUN

	help
	  Sets up the enftun data link on the Xaptum Router Card

	  https://github.com/xaptum/xaprc
```

## buildroot-external-xaptum/package/enftun/Config.in
```kconfig
config BR2_PACKAGE_ENFTUN
	bool "enftun"
	select BR2_PACKAGE_XTT
	select BR2_PACKAGE_LIBCONFIG
	select BR2_PACKAGE_LIBUV
	select BR2_PACKAGE_LIBOPENSSL11

	help
	  enftun is a tunnel client for connecting to the Xaptum Edge
	  Network Fabric (ENF).

	  https://github.com/xaptum/enftun

if BR2_PACKAGE_XAP_USB_GADGET
config BR2_PACKAGE_ENFTUN_HSS
       bool "Include HSS support in Enftun"
       default y
       help
         Attempt to use HSS connections if the deafult connection method fails
endif
```

## buildroot-external-xaptum/package/etc-hosts/Config.in
```kconfig
config BR2_PACKAGE_ETC_HOSTS
	bool "etc-hosts"

	help
	  Installs the /etc/hosts file.

	  https://github.com/xaptum/xaprc

choice
	prompt "Install /etc/hosts file for which environment."
	depends on BR2_PACKAGE_ETC_HOSTS

	config BR2_PACKAGE_ETC_HOSTS_DEV
		bool "dev"

	config BR2_PACKAGE_ETC_HOSTS_PROD
		bool "prod"

endchoice
```

## buildroot-external-xaptum/package/f_hss/Config.in
```kconfig
config BR2_PACKAGE_F_HSS
	bool "HSS USB Gadget Driver"
	depends on BR2_PACKAGE_HSS_NET

	help
	  HSS USB gadget driver.
```

## buildroot-external-xaptum/package/gt/Config.in
```kconfig
config BR2_PACKAGE_GT
	bool "gt"
	select BR2_PACKAGE_LIBCONFIG
	select BR2_PACKAGE_LIBGLIB2
	select BR2_PACKAGE_LIBUSBGX
	help
	Gadget-tool is command line tool for setting USB gadget using
	configFS.

	  https://github.com/kopasiak/gt
```

## buildroot-external-xaptum/package/hss-net/Config.in
```kconfig
config BR2_PACKAGE_HSS_NET
	bool "HSS Socket Driver"
	depends on BR2_LINUX_KERNEL_EXT_HSS

	help
	  HSS network driver.
```

## buildroot-external-xaptum/package/hss/Config.in
```kconfig
config BR2_PACKAGE_HSS
	bool

	help
	  This configuration should only be selected by linux-ext-hss
```

## buildroot-external-xaptum/package/infineon-tpm-update/Config.in
```kconfig
config BR2_PACKAGE_INFINEON_TPM_UPDATE
	bool "Infineon TPM Update Tool"
	select BR2_PACKAGE_OPENSSL
	help
	  Firmware update utility for Infineon TPMs.
```

## buildroot-external-xaptum/package/libopenssl11/Config.in
```kconfig
config BR2_PACKAGE_LIBOPENSSL11
	bool "libopenssl11"
	select BR2_PACKAGE_ZLIB

	help
	  A collaborative effort to develop a robust, commerical-grade,
	  fully featured, and Open Source toolkit implementing the
	  Secure Sockets Layer (SSL v2/v3) and Transport Security
	  (TLS v1) as well as full-strength general-purpose
	  cryptography library.

	  http://www.openssl.org/

	  Note: Some helper scripts need perl.
```

## buildroot-external-xaptum/package/libusbgx-custom/Config.in
```kconfig
config BR2_PACKAGE_LIBUSBGX_CUSTOM
	bool "libusbgx_custom"
	depends on BR2_TOOLCHAIN_HAS_THREADS && !BR2_PACKAGE_LIBUSBGX
	select BR2_PACKAGE_LIBCONFIG
	help
	  libusbgx is a C library encapsulating the kernel USB
	  gadget-configfs userspace API functionality.

	  https://github.com/libusbgx/libusbgx

comment "libusbgx needs a toolchain w/ threads"
	depends on !BR2_TOOLCHAIN_HAS_THREADS

comment "libusbgx_custom cannot be configured with libusbgx"
	depends on BR2_PACKAGE_LIBUSBGX
```

## buildroot-external-xaptum/package/macset/Config.in
```kconfig
config BR2_PACKAGE_MACSET
	bool "macset"

	help
	  Installs the macset helper.

	  https://github.com/xaptum/xaprc

if BR2_PACKAGE_MACSET

config BR2_PACKAGE_MACSET_WLAN0
	bool "wlan0 config"
	default y
	help
	  Install default config for wlan0

endif
```
