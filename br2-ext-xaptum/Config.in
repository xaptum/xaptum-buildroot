## br2-ext-xaptum/Config.in
```kconfig
source "$BR2_EXTERNAL_XAPTUM_PATH/package/amcl/Config.in"
source "$BR2_EXTERNAL_XAPTUM_PATH/package/ecdaa/Config.in"
source "$BR2_EXTERNAL_XAPTUM_PATH/package/xaptum-tpm/Config.in"
```

## br2-ext-xaptum/configs/xaptum_xapnr000_defconfig
```kconfig
BR2_arm=y
BR2_cortex_a5=y
BR2_ARM_ENABLE_NEON=y
BR2_ARM_ENABLE_VFP=y
BR2_ARM_INSTRUCTIONS_THUMB2=y
BR2_CCACHE=y
BR2_PACKAGE_HOST_LINUX_HEADERS_CUSTOM_4_9=y
BR2_TOOLCHAIN_BUILDROOT_WCHAR=y
BR2_PTHREAD_DEBUG=y
BR2_TOOLCHAIN_BUILDROOT_CXX=y
BR2_ROOTFS_DEVICE_CREATION_DYNAMIC_EUDEV=y
BR2_ROOTFS_POST_IMAGE_SCRIPT="support/scripts/genimage.sh"
BR2_ROOTFS_POST_SCRIPT_ARGS="-c $(BR2_EXTERNAL_XAPTUM_PATH)/board/xapnr000/genimage.cfg"
BR2_LINUX_KERNEL=y
BR2_LINUX_KERNEL_CUSTOM_GIT=y
BR2_LINUX_KERNEL_CUSTOM_REPO_URL="https://github.com/drbild/linux-at91.git"
BR2_LINUX_KERNEL_CUSTOM_REPO_VERSION="xaptum"
BR2_LINUX_KERNEL_USE_CUSTOM_CONFIG=y
BR2_LINUX_KERNEL_CUSTOM_CONFIG_FILE="$(BR2_EXTERNAL_XAPTUM_PATH)/board/xapnr000/kernel.config"
BR2_LINUX_KERNEL_DTS_SUPPORT=y
BR2_LINUX_KERNEL_INTREE_DTS_NAME="at91-sama5d2_xplained at91-sama5d2_xplained_pda4 at91-sama5d2_xplained_pda7 at91-sama5d2_xplained_pda7b"
BR2_LINUX_KERNEL_INSTALL_TARGET=y
BR2_PACKAGE_BUSYBOX_SHOW_OTHERS=y
BR2_PACKAGE_USBUTILS=y
BR2_PACKAGE_IPROUTE2=y
BR2_PACKAGE_IPTABLES=y
BR2_PACKAGE_BASH=y
BR2_TARGET_ROOTFS_EXT2=y
BR2_TARGET_ROOTFS_EXT2_4=y
BR2_TARGET_AT91BOOTSTRAP3=y
BR2_TARGET_AT91BOOTSTRAP3_CUSTOM_GIT=y
BR2_TARGET_AT91BOOTSTRAP3_CUSTOM_REPO_URL="https://github.com/linux4sam/at91bootstrap.git"
BR2_TARGET_AT91BOOTSTRAP3_CUSTOM_REPO_VERSION="v3.8.9"
BR2_TARGET_AT91BOOTSTRAP3_DEFCONFIG="sama5d2_xplainedsd_uboot"
BR2_TARGET_UBOOT=y
BR2_TARGET_UBOOT_BUILD_SYSTEM_KCONFIG=y
BR2_TARGET_UBOOT_CUSTOM_GIT=y
BR2_TARGET_UBOOT_CUSTOM_REPO_URL="https://github.com/linux4sam/u-boot-at91.git"
BR2_TARGET_UBOOT_CUSTOM_REPO_VERSION="linux4sam_5.7"
BR2_TARGET_UBOOT_BOARD_DEFCONFIG="sama5d2_xplained_mmc"
BR2_TARGET_UBOOT_NEEDS_DTC=y
BR2_PACKAGE_HOST_DOSFSTOOLS=y
BR2_PACKAGE_HOST_GENIMAGE=y
BR2_PACKAGE_HOST_MTOOLS=y
```

## br2-ext-xaptum/package/ecdaa/Config.in
```kconfig
config BR2_PACKAGE_ECDAA
	bool "ecdaa"
	depends on BR2_PACKAGE_AMCL
	depends on BR2_PACKAGE_AMCL_CURVE
	help
	  ECDAA is a C implementation of elliptic-curve-based
	  Direct Anonymous Attestation (DAA) signatures.

	  https://github.com/xaptum/ecdaa

if BR2_PACKAGE_ECDAA

config BR2_PACKAGE_ECDAA_TPM_SUPPORT
	bool "TPM support"
	default y
	depends on BR2_PACKAGE_XAPTUM_TPM
	help
	  Support using a TPM 2.0 for DAA signatures.

config BR2_PACKAGE_ECDAA_USE_LIBSODIUM
	bool "Use the libsodium RNG"
	default y
	depends on BR2_PACKAGE_LIBSODIUM
	help
	  Use the libsodium RNG. Without this, the user must
	  supply their own.

config BR2_PACKAGE_ECDAA_CURVE_BN254
	bool "BN254"
	depends on BR2_PACKAGE_AMCL_CURVE_BN254

config BR2_PACKAGE_ECDAA_CURVE_BN254CX
	bool "BN254CX"
	depends on BR2_PACKAGE_AMCL_CURVE_BN254CX

config BR2_PACKAGE_ECDAA_CURVE_BLS383
	bool "BLS383"
	depends on BR2_PACKAGE_AMCL_CURVE_BLS383

config BR2_PACKAGE_ECDAA_CURVE_FP256BN
	depends on BR2_PACKAGE_AMCL_CURVE_FP256BN
	bool "FP256BN"

endif
```

## br2-ext-xaptum/package/xaptum-tpm/Config.in
```kconfig
config BR2_PACKAGE_XAPTUM_TPM
	bool "xaptum-tpm"
	help
	  Utilities for interacting with the TPM 2.0 chip used to access the
	  Xaptum Edge Network Fabric.

	  https://github.com/xaptum/xaptum-tpm
```

## br2-ext-xaptum/package/xtt/Config.in
```kconfig
config BR2_PACKAGE_XTT
	bool "xtt"
	select BR2_PACKAGE_ECDAA
	select BR2_PACKAGE_ECDAA_CURVE_FP256BN
	select BR2_PACKAGE_LIBSODIUM
	help
	  XTT is a C implementation of the XTT Trusted Transit protocol
	  for securing Internet of Things (IoT) devices and network
	  traffic.

	  https://github.com/xaptum/xtt

if BR2_PACKAGE_XTT

config BR2_PACKAGE_XTT_TPM_SUPPORT
	bool "TPM support"
	default y
	select BR2_PACKAGE_ECDAA_TPM_SUPPORT
	select BR2_PACKAGE_XAPTUM_TPM
	help
	  Support using a TPM 2.0 for DAA signatures.

config BR2_PACKAGE_XTT_UTILS
       bool "Utility programs"
       default n
       help
         Install utility programs for examining the TPM contents.

endif
```

## buildroot-external-xaptum/Config.in
```kconfig
source "$BR2_EXTERNAL_XAPTUM_PATH/package/amcl/Config.in"
source "$BR2_EXTERNAL_XAPTUM_PATH/package/ecdaa/Config.in"
source "$BR2_EXTERNAL_XAPTUM_PATH/package/enftun/Config.in"
source "$BR2_EXTERNAL_XAPTUM_PATH/package/infineon-tpm-update/Config.in"
source "$BR2_EXTERNAL_XAPTUM_PATH/package/libopenssl11/Config.in"
source "$BR2_EXTERNAL_XAPTUM_PATH/package/mender-certs/Config.in"
source "$BR2_EXTERNAL_XAPTUM_PATH/package/mender-identity/Config.in"
source "$BR2_EXTERNAL_XAPTUM_PATH/package/tpm-proxy/Config.in"
source "$BR2_EXTERNAL_XAPTUM_PATH/package/xapea00x/Config.in"
source "$BR2_EXTERNAL_XAPTUM_PATH/package/xaprc_eval_tool/Config.in.host"
source "$BR2_EXTERNAL_XAPTUM_PATH/package/xaptum-tpm/Config.in"
source "$BR2_EXTERNAL_XAPTUM_PATH/package/xbridge/Config.in"
source "$BR2_EXTERNAL_XAPTUM_PATH/package/xtt/Config.in"
```

## buildroot-external-xaptum/configs/sama5d2_xplained_xaprc_defconfig
```kconfig
BR2_arm=y
BR2_cortex_a5=y
BR2_ARM_ENABLE_NEON=y
BR2_ARM_ENABLE_VFP=y
BR2_ARM_INSTRUCTIONS_THUMB2=y
BR2_CCACHE=y
BR2_GLOBAL_PATCH_DIR="$(BR2_EXTERNAL_XAPTUM_PATH)/patches"
BR2_TOOLCHAIN_BUILDROOT_GLIBC=y
BR2_PACKAGE_HOST_LINUX_HEADERS_CUSTOM_4_14=y
BR2_INIT_SYSTEMD=y
BR2_TARGET_GENERIC_GETTY_PORT="ttyS0"
BR2_ROOTFS_OVERLAY="$(BR2_EXTERNAL_XAPTUM_PATH)/board/sama5d2_xplained_xaprc001/rootfs_overlay"
BR2_ROOTFS_POST_BUILD_SCRIPT="$(BR2_EXTERNAL_XAPTUM_PATH)/board/sama5d2_xplained_xaprc001/post_build.sh"
BR2_ROOTFS_POST_IMAGE_SCRIPT="support/scripts/genimage.sh"
BR2_ROOTFS_POST_SCRIPT_ARGS="-c $(BR2_EXTERNAL_XAPTUM_PATH)/board/sama5d2_xplained_xaprc001/genimage.cfg"
BR2_LINUX_KERNEL=y
BR2_LINUX_KERNEL_CUSTOM_VERSION=y
BR2_LINUX_KERNEL_CUSTOM_VERSION_VALUE="4.14.47"
BR2_LINUX_KERNEL_USE_CUSTOM_CONFIG=y
BR2_LINUX_KERNEL_CUSTOM_CONFIG_FILE="$(BR2_EXTERNAL_XAPTUM_PATH)/board/sama5d2_xplained_xaprc001/linux.config"
BR2_LINUX_KERNEL_DTS_SUPPORT=y
BR2_LINUX_KERNEL_INTREE_DTS_NAME="at91-sama5d2_xplained"
BR2_LINUX_KERNEL_INSTALL_TARGET=y
BR2_PACKAGE_UBOOT_TOOLS=y
BR2_PACKAGE_CONNMAN=y
BR2_PACKAGE_CONNMAN_WIFI=y
BR2_PACKAGE_CONNMAN_LOOPBACK=y
BR2_PACKAGE_TCPDUMP=y
# BR2_PACKAGE_SYSTEMD_HOSTNAMED is not set
# BR2_PACKAGE_SYSTEMD_HWDB is not set
# BR2_PACKAGE_SYSTEMD_MYHOSTNAME is not set
# BR2_PACKAGE_SYSTEMD_NETWORKD is not set
# BR2_PACKAGE_SYSTEMD_RESOLVED is not set
# BR2_PACKAGE_SYSTEMD_TIMEDATED is not set
# BR2_PACKAGE_SYSTEMD_TIMESYNCD is not set
# BR2_PACKAGE_SYSTEMD_TMPFILES is not set
BR2_TARGET_ROOTFS_EXT2=y
BR2_TARGET_ROOTFS_EXT2_4=y
BR2_TARGET_ROOTFS_EXT2_SIZE="50M"
BR2_TARGET_AT91BOOTSTRAP3=y
BR2_TARGET_AT91BOOTSTRAP3_CUSTOM_GIT=y
BR2_TARGET_AT91BOOTSTRAP3_CUSTOM_REPO_URL="https://github.com/linux4sam/at91bootstrap.git"
BR2_TARGET_AT91BOOTSTRAP3_CUSTOM_REPO_VERSION="v3.8.10"
BR2_TARGET_AT91BOOTSTRAP3_DEFCONFIG="sama5d2_xplainedemmc_uboot"
BR2_TARGET_UBOOT=y
BR2_TARGET_UBOOT_BUILD_SYSTEM_KCONFIG=y
BR2_TARGET_UBOOT_CUSTOM_VERSION=y
BR2_TARGET_UBOOT_CUSTOM_VERSION_VALUE="2018.05"
BR2_TARGET_UBOOT_USE_CUSTOM_CONFIG=y
BR2_TARGET_UBOOT_CUSTOM_CONFIG_FILE="$(BR2_EXTERNAL_XAPTUM_PATH)/board/sama5d2_xplained_xaprc001/uboot.config"
BR2_TARGET_UBOOT_NEEDS_DTC=y
BR2_TARGET_UBOOT_ENVIMAGE=y
BR2_TARGET_UBOOT_ENVIMAGE_SOURCE="$(BR2_EXTERNAL_XAPTUM_PATH)/board/sama5d2_xplained_xaprc001/uboot-env.txt"
BR2_TARGET_UBOOT_ENVIMAGE_SIZE="0x1000"
BR2_PACKAGE_HOST_DOSFSTOOLS=y
BR2_PACKAGE_HOST_GENEXT2FS=y
BR2_PACKAGE_HOST_GENIMAGE=y
BR2_PACKAGE_HOST_MTOOLS=y
# BR2_PACKAGE_AMCL_RSA is not set
# BR2_PACKAGE_AMCL_CURVE_BN254CX is not set
# BR2_PACKAGE_AMCL_CURVE_ED25519 is not set
# BR2_PACKAGE_AMCL_CURVE_GOLDILOCKS is not set
# BR2_PACKAGE_AMCL_CURVE_NIST256 is not set
# BR2_PACKAGE_AMCL_MPIN is not set
# BR2_PACKAGE_AMCL_WCC is not set
BR2_PACKAGE_ENFTUN=y
BR2_PACKAGE_XAPEA00X=y
BR2_PACKAGE_HOST_XAPRC_EVAL_TOOL=y
BR2_PACKAGE_XTT_UTILS=y
```

## buildroot-external-xaptum/configs/xaprc001_defconfig
```kconfig
BR2_arm=y
BR2_cortex_a5=y
BR2_ARM_ENABLE_NEON=y
BR2_ARM_ENABLE_VFP=y
BR2_ARM_INSTRUCTIONS_THUMB2=y
BR2_CCACHE=y
BR2_GLOBAL_PATCH_DIR="$(BR2_EXTERNAL_XAPTUM_PATH)/patches"
BR2_TOOLCHAIN_EXTERNAL=y
BR2_INIT_SYSTEMD=y
BR2_TARGET_GENERIC_GETTY_PORT="ttyS0"
BR2_ROOTFS_OVERLAY="$(BR2_EXTERNAL_XAPTUM_PATH)/board/xaprc-common/rootfs_overlay $(BR2_EXTERNAL_XAPTUM_PATH)/board/xaprc001/rootfs_overlay"
BR2_ROOTFS_POST_BUILD_SCRIPT="$(BR2_EXTERNAL_XAPTUM_PATH)/board/xaprc001/post_build.sh"
BR2_ROOTFS_POST_IMAGE_SCRIPT="support/scripts/genimage.sh  $(BR2_EXTERNAL_XAPTUM_PATH)/board/xaprc-common/post_image.sh"
BR2_ROOTFS_POST_SCRIPT_ARGS="-c $(BR2_EXTERNAL_XAPTUM_PATH)/board/xaprc001/genimage.cfg"
BR2_LINUX_KERNEL=y
BR2_LINUX_KERNEL_CUSTOM_GIT=y
BR2_LINUX_KERNEL_CUSTOM_REPO_URL="git@github.com:xaptum/linux.git"
BR2_LINUX_KERNEL_CUSTOM_REPO_VERSION="f4df802f6bd13a3d299bf7ce5aa68cf7c1e59894"
BR2_LINUX_KERNEL_USE_CUSTOM_CONFIG=y
BR2_LINUX_KERNEL_CUSTOM_CONFIG_FILE="$(BR2_EXTERNAL_XAPTUM_PATH)/board/xaprc001/linux.config"
BR2_LINUX_KERNEL_LZO=y
BR2_LINUX_KERNEL_DTS_SUPPORT=y
BR2_LINUX_KERNEL_CUSTOM_DTS_PATH="$(BR2_EXTERNAL_XAPTUM_PATH)/board/xaprc001/at91-xaprc.dts"
BR2_LINUX_KERNEL_INSTALL_TARGET=y
BR2_PACKAGE_LIBNSS=y
BR2_PACKAGE_LIBUSB=y
BR2_PACKAGE_LIBUSBGX=y
BR2_PACKAGE_IPROUTE2=y
BR2_PACKAGE_IPTABLES=y
BR2_PACKAGE_BASH=y
BR2_PACKAGE_MENDER=y
# BR2_PACKAGE_SYSTEMD_HOSTNAMED is not set
# BR2_PACKAGE_SYSTEMD_HWDB is not set
# BR2_PACKAGE_SYSTEMD_MYHOSTNAME is not set
BR2_TARGET_ROOTFS_EXT2=y
BR2_TARGET_ROOTFS_EXT2_4=y
BR2_TARGET_ROOTFS_EXT2_SIZE="64M"
BR2_TARGET_AT91BOOTSTRAP3=y
BR2_TARGET_AT91BOOTSTRAP3_CUSTOM_GIT=y
BR2_TARGET_AT91BOOTSTRAP3_CUSTOM_REPO_URL="ssh://git@github.com/xaptum/at91bootstrap.git"
BR2_TARGET_AT91BOOTSTRAP3_CUSTOM_REPO_VERSION="652c7b0b324ddf78811da59295e69bbb89e831cd"
BR2_TARGET_AT91BOOTSTRAP3_DEFCONFIG="xaprc001mmc_uboot"
BR2_TARGET_UBOOT=y
BR2_TARGET_UBOOT_BUILD_SYSTEM_KCONFIG=y
BR2_TARGET_UBOOT_CUSTOM_GIT=y
BR2_TARGET_UBOOT_CUSTOM_REPO_URL="ssh://git@github.com/xaptum/uboot.git"
BR2_TARGET_UBOOT_CUSTOM_REPO_VERSION="190f6060ef4326703c09c1551202d1a97646f593"
BR2_TARGET_UBOOT_BOARD_DEFCONFIG="xaprc001"
BR2_TARGET_UBOOT_NEEDS_DTC=y
BR2_PACKAGE_HOST_DOSFSTOOLS=y
BR2_PACKAGE_HOST_GENEXT2FS=y
BR2_PACKAGE_HOST_GENIMAGE=y
BR2_PACKAGE_HOST_MENDER_ARTIFACT=y
BR2_PACKAGE_HOST_MTOOLS=y
# BR2_PACKAGE_AMCL_RSA is not set
# BR2_PACKAGE_AMCL_CURVE_BN254CX is not set
# BR2_PACKAGE_AMCL_CURVE_ED25519 is not set
# BR2_PACKAGE_AMCL_CURVE_GOLDILOCKS is not set
# BR2_PACKAGE_AMCL_MPIN is not set
# BR2_PACKAGE_AMCL_WCC is not set
BR2_PACKAGE_CAPTIVED=y
BR2_PACKAGE_ETC_HOSTS=y
BR2_PACKAGE_ETC_HOSTS_PROD=y
BR2_PACKAGE_MENDER_ARTIFACT_INFO=y
BR2_PACKAGE_MENDER_ARTIFACT_INFO_NAME_PREFIX="xaprc001"
BR2_PACKAGE_MENDER_CERTS=y
BR2_PACKAGE_MENDER_CERTS_PROD=y
BR2_PACKAGE_MENDER_IDENTITY=y
BR2_PACKAGE_HOST_XAPRC_EVAL_TOOL=y
BR2_PACKAGE_XAP_USB_GADGET=y
BR2_PACKAGE_XAP_USB_GADGET_PRODUCT_STR="ENF Router Card"
BR2_PACKAGE_XAP_USB_GADGET_PRODUCT_ID="0x8b01"
BR2_PACKAGE_XTT=y
```

## buildroot-external-xaptum/configs/xaprc001_dev_defconfig
```kconfig
BR2_arm=y
BR2_cortex_a5=y
BR2_ARM_ENABLE_NEON=y
BR2_ARM_ENABLE_VFP=y
BR2_ARM_INSTRUCTIONS_THUMB2=y
BR2_CCACHE=y
BR2_GLOBAL_PATCH_DIR="$(BR2_EXTERNAL_XAPTUM_PATH)/patches"
BR2_TOOLCHAIN_EXTERNAL=y
BR2_INIT_SYSTEMD=y
BR2_ROOTFS_OVERLAY="$(BR2_EXTERNAL_XAPTUM_PATH)/board/xaprc-common/rootfs_overlay $(BR2_EXTERNAL_XAPTUM_PATH)/board/xaprc001/rootfs_overlay"
BR2_ROOTFS_POST_BUILD_SCRIPT="$(BR2_EXTERNAL_XAPTUM_PATH)/board/xaprc001/post_build.sh"
BR2_ROOTFS_POST_IMAGE_SCRIPT="support/scripts/genimage.sh"
BR2_ROOTFS_POST_SCRIPT_ARGS="-c $(BR2_EXTERNAL_XAPTUM_PATH)/board/xaprc001/genimage.cfg"
BR2_LINUX_KERNEL=y
BR2_LINUX_KERNEL_CUSTOM_VERSION=y
BR2_LINUX_KERNEL_CUSTOM_VERSION_VALUE="4.14.47"
BR2_LINUX_KERNEL_USE_CUSTOM_CONFIG=y
BR2_LINUX_KERNEL_CUSTOM_CONFIG_FILE="$(BR2_EXTERNAL_XAPTUM_PATH)/board/xaprc001/linux_dev.config"
BR2_LINUX_KERNEL_LZO=y
BR2_LINUX_KERNEL_DTS_SUPPORT=y
BR2_LINUX_KERNEL_CUSTOM_DTS_PATH="$(BR2_EXTERNAL_XAPTUM_PATH)/board/xaprc001/at91-xaprc001.dts"
BR2_LINUX_KERNEL_INSTALL_TARGET=y
BR2_PACKAGE_UBOOT_TOOLS=y
BR2_PACKAGE_LIBNSS=y
BR2_PACKAGE_LIBUSB=y
BR2_PACKAGE_IPROUTE2=y
BR2_PACKAGE_IPTABLES=y
BR2_PACKAGE_BASH=y
BR2_PACKAGE_TCPDUMP=y
# BR2_PACKAGE_SYSTEMD_HOSTNAMED is not set
# BR2_PACKAGE_SYSTEMD_HWDB is not set
# BR2_PACKAGE_SYSTEMD_MYHOSTNAME is not set
BR2_TARGET_ROOTFS_EXT2=y
BR2_TARGET_ROOTFS_EXT2_4=y
BR2_TARGET_ROOTFS_EXT2_SIZE="64M"
BR2_TARGET_AT91BOOTSTRAP3=y
BR2_TARGET_AT91BOOTSTRAP3_CUSTOM_GIT=y
BR2_TARGET_AT91BOOTSTRAP3_CUSTOM_REPO_URL="ssh://git@github.com/xaptum/at91bootstrap.git"
BR2_TARGET_AT91BOOTSTRAP3_CUSTOM_REPO_VERSION="94b760910d2711de73cd15171f01033152f0696e"
BR2_TARGET_AT91BOOTSTRAP3_DEFCONFIG="xaprc001mmc_uboot_dev"
BR2_TARGET_UBOOT=y
BR2_TARGET_UBOOT_BUILD_SYSTEM_KCONFIG=y
BR2_TARGET_UBOOT_CUSTOM_GIT=y
BR2_TARGET_UBOOT_CUSTOM_REPO_URL="ssh://git@github.com/xaptum/uboot.git"
BR2_TARGET_UBOOT_CUSTOM_REPO_VERSION="0fb6c2208f5f4b3a6c5a59e4778fc9ea7e1a399a"
BR2_TARGET_UBOOT_BOARD_DEFCONFIG="xaprc001_dev"
BR2_TARGET_UBOOT_NEEDS_DTC=y
BR2_PACKAGE_HOST_DOSFSTOOLS=y
BR2_PACKAGE_HOST_GENEXT2FS=y
BR2_PACKAGE_HOST_GENIMAGE=y
BR2_PACKAGE_HOST_MTOOLS=y
# BR2_PACKAGE_AMCL_RSA is not set
# BR2_PACKAGE_AMCL_CURVE_BN254CX is not set
# BR2_PACKAGE_AMCL_CURVE_ED25519 is not set
# BR2_PACKAGE_AMCL_CURVE_GOLDILOCKS is not set
# BR2_PACKAGE_AMCL_MPIN is not set
# BR2_PACKAGE_AMCL_WCC is not set
BR2_PACKAGE_HOST_XAPRC_EVAL_TOOL=y
BR2_PACKAGE_XAPTUM_TPM_UTILS=y
BR2_PACKAGE_XTT=y
BR2_PACKAGE_XTT_UTILS=y
```
